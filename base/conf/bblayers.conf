## base/conf/bblayers.conf
```bitbake
LCONF_VERSION = "6"

BBPATH = "${TOPDIR}"
BSPDIR := "${@os.path.abspath(os.path.dirname(d.getVar('FILE', True)) + '/../..')}"

BBFILES ?= ""
BBLAYERS = " \
  ${BSPDIR}/sources/poky/meta \
  ${BSPDIR}/sources/poky/meta-poky \
  \
  ${BSPDIR}/sources/meta-trimble \
  \
  ${BSPDIR}/sources/poky/meta-freescale \
  ${BSPDIR}/sources/poky/meta-freescale-3rdparty \
  ${BSPDIR}/sources/poky/meta-freescale-distro \
  \
  ${BSPDIR}/sources/poky/meta-xilinx \
"
```
